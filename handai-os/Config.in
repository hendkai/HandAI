## handai-os/configs/qemu_aarch64_handai_defconfig
```kconfig
# HandAI OS — QEMU aarch64 'virt' target for testing WITHOUT hardware.
# Unlike the RG35xxSP target, this builds a real mainline kernel (QEMU virt is
# fully supported), so there are NO vendor blobs to source. It boots the exact
# same rootfs + init flow + cockpit under emulation — the highest-fidelity way
# to test everything except the SoC-specific display/gamepad bits.
#
#   make BR2_EXTERNAL=/path/to/handai-os qemu_aarch64_handai_defconfig
#   make -j"$(nproc)"
#   ./handai-os/board/qemu/run-qemu.sh          # boots into the cockpit on serial

BR2_aarch64=y
BR2_cortex_a53=y
BR2_TOOLCHAIN_BUILDROOT_GLIBC=y

# init: same as the device — busybox, cockpit as respawn service (no login getty)
BR2_INIT_BUSYBOX=y
BR2_TARGET_GENERIC_HOSTNAME="handai-qemu"
# BR2_TARGET_GENERIC_GETTY is not set

# mainline kernel for the QEMU 'virt' machine (built here, no blobs).
# arm64's defconfig is arch/arm64/configs/defconfig; Buildroot appends
# "_defconfig" to a *named* defconfig, so a named value would look for
# "defconfig_defconfig". Use the arch default config instead.
BR2_LINUX_KERNEL=y
BR2_LINUX_KERNEL_USE_ARCH_DEFAULT_CONFIG=y
BR2_LINUX_KERNEL_IMAGE=y

# HandAI cockpit + runtime (pulls python3/tmux/openssh/ca-certificates)
BR2_PACKAGE_HANDAI=y

# no Node / no SDL here — integration tests use the fake-agent stub (offline),
# which keeps the emulated build small and fast.

# wired NAT networking in the VM (so you can test agents reaching real APIs).
# run-qemu.sh attaches a virtio-net device; this DHCPs it at boot.
BR2_SYSTEM_DHCP="eth0"

BR2_TARGET_ROOTFS_EXT2=y
BR2_TARGET_ROOTFS_EXT2_4=y
BR2_TARGET_ROOTFS_EXT2_SIZE="256M"

# two overlays: the shared device overlay (init service + config) + a QEMU one
# that overrides the tty (ttyAMA0) and drops in the offline demo config.
BR2_ROOTFS_OVERLAY="$(BR2_EXTERNAL_HANDAI_PATH)/board/rg35xxsp/rootfs-overlay $(BR2_EXTERNAL_HANDAI_PATH)/board/qemu/rootfs-overlay"
# post-build: set exec bits on overlay scripts (host FS may not carry them)
BR2_ROOTFS_POST_BUILD_SCRIPT="$(BR2_EXTERNAL_HANDAI_PATH)/board/post-build.sh"
```

## handai-os/configs/rg35xxsp_handai_defconfig
```kconfig
# HandAI OS — RG35xxSP (Allwinner H700, Cortex-A53 arm64) defconfig
# Kernel/boot layout comes from a SHA-256-pinned official KNULLI RG35xxSP image.
# Buildroot supplies the HandAI userland that replaces KNULLI's SquashFS.

BR2_aarch64=y
BR2_cortex_a53=y

# The H700 BSP kernel is 4.9.170. Without this explicit ABI floor Buildroot
# picks its newest headers and may emit binaries without fallbacks required by
# the device kernel ("for GNU/Linux 7.0.0").
BR2_KERNEL_HEADERS_VERSION=y
BR2_DEFAULT_KERNEL_VERSION="4.9.337"
BR2_PACKAGE_HOST_LINUX_HEADERS_CUSTOM_4_9=y
BR2_GLOBAL_PATCH_DIR="$(BR2_EXTERNAL_HANDAI_PATH)/patches"

# glibc: Node prebuilts (claude/codex/opencode CLIs) expect glibc, not musl
BR2_TOOLCHAIN_BUILDROOT_GLIBC=y
BR2_TOOLCHAIN_BUILDROOT_CXX=y

# init: busybox, cockpit runs as a respawn service (no login getty)
BR2_INIT_BUSYBOX=y
BR2_TARGET_GENERIC_HOSTNAME="handai"
BR2_TARGET_GENERIC_ISSUE="HandAI OS"
BR2_SYSTEM_BIN_SH_BUSYBOX=y
BR2_PACKAGE_BUSYBOX_SHOW_OTHERS=y
# no getty — the cockpit owns the console tty (S99handai respawns it)
# BR2_TARGET_GENERIC_GETTY is not set

# --- HandAI cockpit + its runtime deps (pull in python3/tmux/openssh/ca-certs)
BR2_PACKAGE_HANDAI=y
BR2_PACKAGE_BASH=y
BR2_PACKAGE_PYTHON3_SSL=y
BR2_PACKAGE_CA_CERTIFICATES=y
BR2_PACKAGE_LIBCURL=y
BR2_PACKAGE_LIBCURL_CURL=y
BR2_PACKAGE_GIT=y
BR2_PACKAGE_XZ=y

# --- networking (WiFi from the cockpit) --------------------------------------
BR2_PACKAGE_WPA_SUPPLICANT=y
BR2_PACKAGE_WPA_SUPPLICANT_CLI=y
BR2_PACKAGE_DHCPCD=y
BR2_PACKAGE_IW=y
BR2_PACKAGE_UTIL_LINUX=y
BR2_PACKAGE_UTIL_LINUX_RFKILL=y
BR2_PACKAGE_WIRELESS_REGDB=y
BR2_PACKAGE_TAILSCALE=y
BR2_PACKAGE_LIBQRENCODE=y
BR2_PACKAGE_LIBQRENCODE_TOOLS=y

# --- microphone + Bluetooth headset voice input -----------------------------
BR2_PACKAGE_ALSA_UTILS=y
BR2_PACKAGE_ALSA_UTILS_APLAY=y
BR2_PACKAGE_ALSA_UTILS_AMIXER=y
BR2_PACKAGE_DBUS=y
BR2_PACKAGE_BLUEZ5_UTILS=y
BR2_PACKAGE_BLUEZ5_UTILS_CLIENT=y
BR2_PACKAGE_BLUEZ5_UTILS_TOOLS=y
BR2_PACKAGE_BLUEZ5_UTILS_PLUGINS_AUDIO=y
BR2_PACKAGE_SBC=y
BR2_PACKAGE_PIPEWIRE=y
BR2_PACKAGE_LIBSNDFILE=y
BR2_PACKAGE_LUA=y
BR2_PACKAGE_LUA_5_4=y
BR2_PACKAGE_WIREPLUMBER=y
BR2_PACKAGE_WHISPERCPP=y
# The WiFi chip's kernel module comes with the borrowed vendor kernel; its
# firmware blob is board-specific — drop it in the overlay under lib/firmware/
# and wire loading via opt/handai/net/chip.sh (see chip.sh.example).

# --- shipped GUI frontend (SDL2 straight to the framebuffer, no X) ----------
BR2_PACKAGE_SDL2=y
BR2_PACKAGE_SDL2_KMSDRM=y

# --- Node.js: required for claude/codex/opencode local CLIs -------------------
# Drop these two lines to build the lighter `handai-remote` image (ssh-only).
BR2_PACKAGE_NODEJS=y
BR2_PACKAGE_NODEJS_NPM=y

# --- rootfs image ------------------------------------------------------------
# post-image builds the booted SquashFS directly; no unused ext2 rootfs artifact
# BR2_TARGET_ROOTFS_EXT2 is not set

# --- our overlay (init service, /etc/handai config) + image assembly ---------
BR2_ROOTFS_OVERLAY="$(BR2_EXTERNAL_HANDAI_PATH)/board/rg35xxsp/rootfs-overlay"
# post-build: set exec bits on overlay scripts (host FS may not carry them)
BR2_ROOTFS_POST_BUILD_SCRIPT="$(BR2_EXTERNAL_HANDAI_PATH)/board/post-build.sh"
BR2_ROOTFS_POST_IMAGE_SCRIPT="$(BR2_EXTERNAL_HANDAI_PATH)/board/rg35xxsp/post-image.sh"
```

## handai-os/configs/rg35xxsp_handai_remote_defconfig
```kconfig
# HandAI OS — RG35xxSP, REMOTE-first variant (the realistic 1 GB target).
# No Node.js / no local agent CLIs: the handheld is a pure remote cockpit and
# the agents (hermes, codex-remote, claude/codex over ssh) run on the devbox or
# cloud. ~90 MB rootfs instead of ~180 MB. Same cockpit, same init, same WiFi.
#
#   make BR2_EXTERNAL=/path/to/handai-os rg35xxsp_handai_remote_defconfig && make

BR2_aarch64=y
BR2_cortex_a53=y
BR2_TOOLCHAIN_BUILDROOT_GLIBC=y
BR2_TOOLCHAIN_BUILDROOT_CXX=y

BR2_INIT_BUSYBOX=y
BR2_TARGET_GENERIC_HOSTNAME="handai"
BR2_TARGET_GENERIC_ISSUE="HandAI OS (remote)"
BR2_SYSTEM_BIN_SH_BUSYBOX=y
BR2_PACKAGE_BUSYBOX_SHOW_OTHERS=y
# BR2_TARGET_GENERIC_GETTY is not set

# cockpit + runtime (python3/tmux/openssh/ca-certificates). NO nodejs here.
BR2_PACKAGE_HANDAI=y
BR2_PACKAGE_BASH=y
BR2_PACKAGE_PYTHON3_SSL=y
BR2_PACKAGE_CA_CERTIFICATES=y
BR2_PACKAGE_LIBCURL=y
BR2_PACKAGE_LIBCURL_CURL=y

# networking (WiFi from the cockpit)
BR2_PACKAGE_WPA_SUPPLICANT=y
BR2_PACKAGE_WPA_SUPPLICANT_CLI=y
BR2_PACKAGE_DHCPCD=y
BR2_PACKAGE_IW=y
BR2_PACKAGE_UTIL_LINUX=y
BR2_PACKAGE_UTIL_LINUX_RFKILL=y
BR2_PACKAGE_WIRELESS_REGDB=y
BR2_PACKAGE_TAILSCALE=y
BR2_PACKAGE_LIBQRENCODE=y
BR2_PACKAGE_LIBQRENCODE_TOOLS=y

# microphone + Bluetooth HFP headset voice input; transcription stays local
BR2_PACKAGE_ALSA_UTILS=y
BR2_PACKAGE_ALSA_UTILS_APLAY=y
BR2_PACKAGE_ALSA_UTILS_AMIXER=y
BR2_PACKAGE_DBUS=y
BR2_PACKAGE_BLUEZ5_UTILS=y
BR2_PACKAGE_BLUEZ5_UTILS_CLIENT=y
BR2_PACKAGE_BLUEZ5_UTILS_TOOLS=y
BR2_PACKAGE_BLUEZ5_UTILS_PLUGINS_AUDIO=y
BR2_PACKAGE_SBC=y
BR2_PACKAGE_PIPEWIRE=y
BR2_PACKAGE_LIBSNDFILE=y
BR2_PACKAGE_LUA=y
BR2_PACKAGE_LUA_5_4=y
BR2_PACKAGE_WIREPLUMBER=y
BR2_PACKAGE_WHISPERCPP=y

# shipped GUI frontend (optional; curses-on-fbcon works without it)
BR2_PACKAGE_SDL2=y
BR2_PACKAGE_SDL2_KMSDRM=y

# post-image builds the booted SquashFS directly; no unused ext2 rootfs artifact
# BR2_TARGET_ROOTFS_EXT2 is not set

BR2_ROOTFS_OVERLAY="$(BR2_EXTERNAL_HANDAI_PATH)/board/rg35xxsp/rootfs-overlay"
BR2_ROOTFS_POST_BUILD_SCRIPT="$(BR2_EXTERNAL_HANDAI_PATH)/board/post-build.sh"
BR2_ROOTFS_POST_IMAGE_SCRIPT="$(BR2_EXTERNAL_HANDAI_PATH)/board/rg35xxsp/post-image.sh"
```

## handai-os/package/handai/Config.in
```kconfig
config BR2_PACKAGE_HANDAI
	bool "handai"
	select BR2_PACKAGE_PYTHON3
	select BR2_PACKAGE_PYTHON3_CURSES  # cockpit UI — without it `import curses` fails
	select BR2_PACKAGE_TMUX
	select BR2_PACKAGE_OPENSSH
	select BR2_PACKAGE_CA_CERTIFICATES
	help
	  HandAI cockpit — gamepad-driven controller for local/remote AI coding
	  agents. Installs the stdlib-only Python package to /opt/handai and the
	  launcher to /usr/bin/handai. The init service boots the device straight
	  into the cockpit.

	  https://github.com/<you>/handai
```

## handai-os/package/whispercpp/Config.in
```kconfig
config BR2_PACKAGE_WHISPERCPP
	bool "whisper.cpp CLI"
	depends on BR2_INSTALL_LIBSTDCPP
	depends on BR2_TOOLCHAIN_HAS_THREADS
	help
	  CPU-only local speech recognition used by HandAI voice input.
	  Model weights are downloaded separately to the persistent data
	  partition from the cockpit.

	  https://github.com/ggml-org/whisper.cpp
```
